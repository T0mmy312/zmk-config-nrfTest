#include <dt-bindings/zmk/matrix_transform.h>

/ {
    chose {
        zmk,kscan = &default_kscan;
        zmk,matrix-transform = &default_transform;
    };

    default_kscan: kscan {
        compatible = "zmk,kscan-gpio-direct";
        label = "default_kscan";

        input-gpios = 
            <&gpio0 12 (GPIO_ACTIVE_HIGH | GPIO_PULL_DOWN)>;
    };

    default_transform: matrix_transform {
        compatible = "zmk,matrix-transform";
        rows = <1>;
        columns = <1>;
        map = <RC(0,0)>;
    };
};